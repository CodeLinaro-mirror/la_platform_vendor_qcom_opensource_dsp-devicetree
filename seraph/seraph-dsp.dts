// SPDX-License-Identifier: BSD-3-Clause
/*
 * Copyright (c) Qualcomm Technologies, Inc. and/or its subsidiaries.
 */

/dts-v1/;
/plugin/;

#include "seraph-dsp.dtsi"

/ {
	model = "Qualcomm Technologies, Inc. Seraph SoC";
	compatible = "qcom,seraph", "qcom,seraphp-atp", "qcom,seraphp", "qcom,atp",
		"qcom,seraph-idp", "qcom,seraphp-idp", "qcom,idp";
	qcom,msm-id = <673 0x10000>, <672 0x10000>;
	qcom,board-id = <0 0>;
};
