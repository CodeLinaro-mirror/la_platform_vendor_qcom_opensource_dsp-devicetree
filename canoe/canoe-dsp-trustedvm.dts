// SPDX-License-Identifier: BSD-3-Clause
/*
 * Copyright (c) 2024 Qualcomm Innovation Center, Inc. All rights reserved.
 */

/dts-v1/;
/plugin/;

#include "canoe-dsp-trustedvm.dtsi"

/ {
	model = "Qualcomm Technologies, Inc. Canoe - TrustedVM";
	compatible = "qcom,canoe";
};
