// SPDX-License-Identifier: BSD-3-Clause
/*
 * Copyright (c) Qualcomm Technologies, Inc. and/or its subsidiaries.
 */
/dts-v1/;
/plugin/;

#include "yupik-dsp.dtsi"

/ {
	model = "Qualcomm Technologies, Inc. Yupik";
	compatible = "qcom,yupik";
	qcom,msm-id = <475 0x10000>, <515 0x10000>, <497 0x10000>,
                       <576 0x10000>, <498 0x10000>, <575 0x10000>;
	qcom,board-id = <0 0>;
};
