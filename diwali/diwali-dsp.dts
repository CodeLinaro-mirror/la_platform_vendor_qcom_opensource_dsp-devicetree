// SPDX-License-Identifier: BSD-3-Clause
/*
 * Copyright (c) Qualcomm Technologies, Inc. and/or its subsidiaries.
 */
/dts-v1/;
/plugin/;

#include "diwali-dsp.dtsi"

/ {
        model = "Qualcomm Technologies, Inc. Diwali";
        compatible = "qcom,diwali";
        qcom,msm-id = <506 0x10000>, <547 0x10000>, <564 0x10000>;
	qcom,board-id = <0 0>, <34 0>;
};
