// SPDX-License-Identifier: BSD-3-Clause
/*
 * Copyright (c) Qualcomm Technologies, Inc. and/or its subsidiaries.
 */
/dts-v1/;
/plugin/;

#include "waipio-dsp.dtsi"

/ {
	model = "Qualcomm Technologies, Inc. Waipio v2";
        compatible = "qcom,waipio";
        qcom,msm-id = <457 0x10000>, <457 0x20000>;
	qcom,board-id = <0 0>;
};
